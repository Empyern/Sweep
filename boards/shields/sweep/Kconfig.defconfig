## boards/shields/sweep/Kconfig.defconfig
```kconfig
if SHIELD_SWEEP_DONGLE || SHIELD_SWEEP_LEFT || SHIELD_SWEEP_RIGHT

config ZMK_SPLIT
    default y

endif # SHIELD_SWEEP_DONGLE || SHIELD_SWEEP_LEFT || SHIELD_SWEEP_RIGHT


if SHIELD_SWEEP_DONGLE || SHIELD_SWEEP_LEFT

config ZMK_SPLIT_ROLE_CENTRAL
    default y

if SHIELD_SWEEP_DONGLE

config ZMK_SPLIT_BLE_CENTRAL_PERIPHERALS
    default 2

config ZMK_SPLIT_BLE_CENTRAL_BATTERY_LEVEL_PROXY
    default y

config ZMK_SPLIT_BLE_CENTRAL_BATTERY_LEVEL_FETCHING
    default y

endif

if ZMK_SPLIT_ROLE_CENTRAL

config ZMK_KEYBOARD_NAME
    default "Sweep"

endif

endif
```

## config/west.yml
```yaml
manifest:
  remotes:
  - name: zmkfirmware
    url-base: https://github.com/zmkfirmware
  - name: englmaxi
    url-base: https://github.com/englmaxi
  projects:
  - name: zmk
    remote: zmkfirmware
    revision: ead91ca094c6cd778574f73b9ae011ddab611c66
    import: app/west.yml  
  - name: zmk-dongle-display
    remote: englmaxi
    revision: main
```
